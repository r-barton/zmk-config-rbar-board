## config/boards/shields/Kconfig.defconfig
```kconfig
if SHIELD_R_BAR_BOARD_LEFT

config ZMK_KEYBOARD_NAME
    default "r_bar_board"

config ZMK_SPLIT_ROLE_CENTRAL
    default y

endif

if SHIELD_R_BAR_BOARD_LEFT || SHIELD_R_BAR_BOARD_RIGHT

config ZMK_SPLIT
    default y

endif
```

## config/boards/shields/r_bar_board/Kconfig.shield
```kconfig
config SHIELD_R_BAR_BOARD_LEFT
    def_bool $(shields_list_contains,r_bar_board_left)

config SHIELD_R_BAR_BOARD_RIGHT
    def_bool $(shields_list_contains,r_bar_board_right)
```

## zmk/config/boards/shields/Kconfig.defconfig
```kconfig
if SHIELD_R-BAR-BOARD_LEFT

config ZMK_KEYBOARD_NAME
    default "r-bar-board"

config ZMK_SPLIT_ROLE_CENTRAL
    default y

endif

if SHIELD_R-BAR-BOARD_LEFT || SHIELD_R-BAR-BOARD_RIGHT

config ZMK_SPLIT
    default y

endif
```

## zmk/config/boards/shields/Kconfig.shield
```kconfig
config SHIELD_R-BAR-BOARD_LEFT
    def_bool $(shields_list_contains,r-bar-board_left)

config SHIELD_R-BAR-BOARD_RIGHT
    def_bool $(shields_list_contains,r-bar-board_right)
```
